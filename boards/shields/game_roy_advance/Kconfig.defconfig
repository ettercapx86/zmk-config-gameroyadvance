## boards/shields/game_roy_advance/Kconfig.defconfig
```kconfig
if SHIELD_GAME_ROY_ADVANCE_LEFT

config ZMK_KEYBOARD_NAME
    default "Gameroyadvance"

config ZMK_SPLIT_BLE_ROLE_CENTRAL
	default y
endif

if SHIELD_GAME_ROY_ADVANCE_LEFT || SHIELD_GAME_ROY_ADVANCE_RIGHT

config ZMK_SPLIT
	default y

endif
```
